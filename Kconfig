## Kconfig
```kconfig
config ZMK_BOOTLOADER_ON_1200_BAUD
    bool "Enter the UF2 bootloader when the host sets a CDC ACM port to 1200 baud"
    depends on USB_CDC_ACM && RETENTION_BOOT_MODE
    select CDC_ACM_DTE_RATE_CALLBACK_SUPPORT
```

## config/west.yml
```yaml
manifest:
  remotes:
    - name: zmkfirmware
      url-base: https://github.com/zmkfirmware
    - name: m165437 #new entry
      url-base: https://github.com/M165437 #new entry
    - name: cormoran
      url-base: https://github.com/cormoran
  projects:
    - name: zmk
      remote: zmkfirmware
      revision: 4dd95d7840eb3d5a3f59bb29fbf1ab054715ef85  # main
      import: app/west.yml
    - name: nice-view-gem #new entry
      remote: m165437 #new entry
      revision: 0a50fe209d929c916c5664c6affd0f4977c6b012  # main
    - name: zmk-feature-default-layer
      remote: cormoran
      revision: 92728246f80d327709839b2dbf5cf11880ff87e1  # main
  self:
    path: config
```
